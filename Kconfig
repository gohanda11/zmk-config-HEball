## Kconfig
```kconfig
config HEBALL_CMD_HANDLER
    bool "HEball binary command handler over CDC ACM"
    default n
    depends on USB_CDC_ACM && SHIELD_HEBALL_RIGHT
    help
      Enables a binary command protocol over a second CDC ACM USB serial port.
      Allows runtime configuration of Hall Effect key thresholds.
      Only available on the right half (requires DT_ALIAS heball_data_uart
      from the heball_right shield overlay).

config HEBALL_BLE_PERIPHERAL
    bool "HEball BLE GATT peripheral (left half)"
    default n
    depends on BT_PERIPHERAL && BT_SMP
    help
      Enable custom GATT service for threshold configuration on the left half.
      Exposes threshold read/write and ADC streaming characteristics over BLE.

config HEBALL_BLE_CENTRAL
    bool "HEball BLE GATT central (right half)"
    default n
    depends on BT_CENTRAL && BT_GATT_CLIENT && BT_SMP
    help
      Enable GATT client for proxying configuration commands to the left half
      over BLE. Discovers the custom HEBALL GATT service on the split peer.
```

## config/west.yml
```yaml
manifest:
  remotes:
    - name: zmkfirmware
      url-base: https://github.com/zmkfirmware
    - name: sekigon-gonnoc
      url-base: https://github.com/sekigon-gonnoc
    - name: gohanda11
      url-base: https://github.com/gohanda11
    - name: badjeff
      url-base: https://github.com/badjeff
    - name: cormoran
      url-base: https://github.com/cormoran
  projects:
    - name: zmk
      remote: cormoran
      revision: v0.3-branch+dya
      import: app/west.yml
    - name: zmk-driver-kscan-he
      remote: gohanda11
      revision: feature/per-key-thresholds
    - name: zmk-pmw3610-driver
      remote: badjeff
      revision: main
    - name: zmk-feature-non-lipo-battery-management
      remote: sekigon-gonnoc
      revision: main
    - name: zmk-rgbled-widget
      remote: gohanda11
      revision: main
    # Dya Studio 連携モジュール (cormoran)
    - name: zmk-module-ble-management
      remote: cormoran
      revision: main
    - name: zmk-module-battery-history
      remote: cormoran
      revision: main
    - name: zmk-module-settings-rpc
      remote: cormoran
      revision: main
    - name: zmk-module-runtime-input-processor
      remote: cormoran
      revision: main
  self:
    path: config
```
